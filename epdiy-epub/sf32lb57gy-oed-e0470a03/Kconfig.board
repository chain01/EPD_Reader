## epdiy-epub/sf32lb57gy-oed-e0470a03/Kconfig.board
```kconfig
config ASIC
    bool
    default y

config EPD_TPS_I2C_DEVICE_NAME
    string
    default "i2c1"

config EPD_TPS_WAKEUP_PIN
    int
    default 42

config EPD_TPS_PWRCOM_PIN
    int
    default 43

config EPD_TPS_PWRUP_PIN
    int
    default 44

config EPD_TPS_GOOD_PIN
    int
    default 52

config TOUCH_IRQ_PIN
    int
    default 3

config TOUCH_DEVICE_NAME
    string
    default "i2c2"

config LCD_BACKLIGHT_CONTROL_PIN
    int
    default 53

config EPD_VCOM_MV
    int "Panel VCOM magnitude in mV (use panel label)"
    range 1500 2500
    default 2100

config WIFI_SDIO_DIAG
    bool "Power Wi-Fi and report its SDIO IDs without loading firmware"
    default n
```

## epdiy-epub/sf32lb57gy-oed-e0470a03/hcpu/Kconfig.board
```kconfig
config BSP_USING_BOARD_SF32LB57GY_OED_E0470A03
    bool
    select SOC_SF32LB57X
    select SOC_SF32LB57GYD7N6
    select BF0_HCPU
    default y

rsource "../Kconfig.board"
```
